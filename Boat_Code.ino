#include <BLEDevice.h>
#include <BLEUtils.h>
#include <BLEScan.h>
#include <BLEAdvertisedDevice.h>

int scanTime = 5; //In seconds
BLEScan* pBLEScan;

//set up lcd 
#include <SPI.h>
#include <Wire.h>
#include <Adafruit_GFX.h>
#include <Adafruit_SSD1306.h>
#define SCREEN_WIDTH 128 // OLED display width, in pixels
#define SCREEN_HEIGHT 32 // OLED display height, in pixels
#define OLED_RESET     -1 // Reset pin # (or -1 if sharing Arduino reset pin)
#define SCREEN_ADDRESS 0x3C ///< See datasheet for Address; 0x3D for 128x64, 0x3C for 128x32
Adafruit_SSD1306 display(SCREEN_WIDTH, SCREEN_HEIGHT, &Wire, OLED_RESET);

void turtleSafe(float distance);
void turtleUnsafe(float distance);
void turtleDed(float distance);

const uint8_t PROGMEM batman[] = {
0x00, 0x00, 0x00, 0x00, 0x00, 0x00, 0x00, 0x00, 0x00, 0x00, 0x00, 0x00, 0x00, 0x00, 0x00, 0x00, 
0x00, 0x00, 0x00, 0x00, 0x00, 0x00, 0x00, 0x00, 0x00, 0x00, 0x00, 0x00, 0x00, 0x00, 0x00, 0x00, 
0x00, 0x00, 0x00, 0x00, 0x00, 0x00, 0x00, 0x00, 0x00, 0x00, 0x00, 0x00, 0x00, 0x00, 0x00, 0x00, 
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0x00, 0x00, 0x00, 0x00, 0x00, 0x00, 0x00, 0x00, 0x00, 0x00, 0x00, 0x00, 0x00, 0x00, 0x00, 0x00
};

class MyAdvertisedDeviceCallbacks: public BLEAdvertisedDeviceCallbacks {
    void onResult(BLEAdvertisedDevice advertisedDevice) {
      int TxPower = advertisedDevice.getTXPower(); 
      float RSSIValue = advertisedDevice.getRSSI();  
      //float temp2 = ((3 - advertisedDevice.getRSSI()) / 100); 
      //int distance = 2; 
      float distance = pow(10, ((3 - RSSIValue) / 100)) - 3; 
      //float distance = pow(10, ((-1.0*TxPower - RSSIValue)/20) );
      if (advertisedDevice.getAddress().toString() == "94:b5:55:c7:31:a6") {
              //float RSSIValue = advertisedDevice.getRSSI();  
              //float temp2 = ((3 - advertisedDevice.getRSSI()) / 100);
               
              //Serial.print("distance: "); 
              //Serial.println(distance); 
              Serial.println(distance); 
              display.clearDisplay();
              display.setTextSize(1); //sets font size
              display.setCursor(0,0); 
              //display.print(distance);
              display.display();
              if(distance < 2.0f){
                turtleDed(distance);
              } else if( 2.0f < distance < 4.0f){
                turtleUnsafe(distance);
              } else if (distance > 4.0f){
                turtleSafe(distance);
              } else {
                return;
              }

          // Show the display buffer on the screen. You MUST call display() after
          // drawing commands to make them visible on screen!
            display.display();

      }
      
    }
    // Get TxPower
    signed char getTxPower(BLEAdvertisedDevice device) {
      const signed char* pTxPower = (const signed char*)&device
                                    .getManufacturerData()
                                    .c_str()[24];
      return *pTxPower;
    }
};
//Set up ESPNOW 


void setup() {
  Serial.begin(115200);
  //Serial.println(F("Scanning..."));

  BLEDevice::init("DontSaveTheTurtles");
  pBLEScan = BLEDevice::getScan(); //create new scan
  pBLEScan->setAdvertisedDeviceCallbacks(new MyAdvertisedDeviceCallbacks());
  pBLEScan->setActiveScan(true); //active scan uses more power, but get results faster
  pBLEScan->setInterval(100);
  pBLEScan->setWindow(99);  // less or equal setInterval value
  
  //ESPNow Mode 
  Serial.begin(115200); 




  if(!display.begin(SSD1306_SWITCHCAPVCC, SCREEN_ADDRESS)) {
    Serial.println(F("SSD1306 allocation failed"));
    for(;;); // Don't proceed, loop forever
  }
  
  delay(2000); // Pause for 2 seconds
  // Clear the buffer


  
}
void loop() {
  // put your main code here, to run repeatedly:
  BLEScanResults foundDevices = pBLEScan->start(scanTime, false);
  pBLEScan->clearResults();   // delete results fromBLEScan buffer to release memory
  delay(2000);
}



void turtleSafe(float distance){
  display.clearDisplay();
  display.display();
  display.drawBitmap(65,0,batman,128,64,WHITE);
  display.setCursor(0, 0);
    display.setTextColor(WHITE);
  display.println("  CLEAR!! ");
  display.println("   No Turtles");
  display.print(" ");
  display.print(distance);
  display.print("  away!");
  // display.println((char) distance);
  display.invertDisplay(false);
  display.display();

}

void turtleUnsafe(float distance){
  display.clearDisplay();
  display.display();
  display.drawBitmap(65,0,batman,128,64,WHITE);
  display.setCursor(0, 0);
    display.setTextColor(WHITE);
  display.println("  WARNING!!");
  display.println("   Turtle");
  display.print(" ");
  display.print(distance);
  display.print("  away!");
  // display.println((char) distance);
  display.display();

  for(int i = 0; i < 5; i++){
    display.invertDisplay(true);
    display.display();
    delay(1000);
  }

}

void turtleDed(float distance){
  display.clearDisplay();
  display.display();
  display.setCursor(0, 0);
  display.setTextColor(WHITE);
  display.println("  Critical!!");
  display.println("   Warning");
  display.print(" ");
  display.print(distance);
  display.print("  away!");
  display.display();
  display.drawBitmap(80,0,batman,128,64,WHITE);
  display.display();

   for(int i = 0; i < 10; i++){
    display.invertDisplay(true);
    display.display();
    delay(500);
  //     display.print("WARNING!! Turtle ");
  // display.print((char) distance);
  // display.println("away!");
    display.invertDisplay(false);
    display.display();

   }

//Serial.println("Turtle Die :(");

}
